## sdkconfig.defaults
```kconfig
# Console via USB CDC (ESP32-S2 native USB — no separate UART adapter needed)
CONFIG_ESP_CONSOLE_UART_NUM=-1
CONFIG_ESP_CONSOLE_USB_CDC=y
CONFIG_ESP_CONSOLE_USB_CDC_RX_BUF_SIZE=64

# HTTP client — disable HTTPS to save flash space
CONFIG_ESP_HTTP_CLIENT_ENABLE_HTTPS=n

# LwIP networking
CONFIG_LWIP_MAX_SOCKETS=16
CONFIG_LWIP_TCP_MSL=3000
CONFIG_LWIP_TCP_FIN_WAIT_TIMEOUT=1000
CONFIG_LWIP_IPV6=n

# HTTP server — WebSocket support required, larger header buffer for browser requests
CONFIG_HTTPD_MAX_REQ_HDR_LEN=1024
CONFIG_HTTPD_WS_SUPPORT=y

# Stack size for app_main (DNS loop + HTTP handlers)
CONFIG_ESP_MAIN_TASK_STACK_SIZE=8192
```
